/dts-v1/;
/plugin/;

#include <dt-bindings/leds/common.h>

&{/} {
	leds {
		led-1 {
			function = LED_FUNCTION_INDICATOR;
			default-state = "off";
			linux,default-trigger = "none";
		};

		led-2 {
			function = LED_FUNCTION_INDICATOR;
			default-state = "off";
			linux,default-trigger = "none";
		};
	};
};
