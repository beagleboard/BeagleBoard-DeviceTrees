/* macro: BONE_PIN( <pin>, <mode_name>, <register_value_macro(s)> */
#define BONE_PIN(XX,ZZ,QQ) \
	XX##_##ZZ##_pin: pinmux_##XX##_##ZZ##_pin { pinctrl-single,pins = < QQ >; };

	/* Full P8/P9 header mode definitions */
	/* P8_01 - GND */
	/* P8_02 - GND */

	/* P8_03 (AH21) PRG1_PRU0_GPO19 (gpio0_20) */
	BONE_PIN(P8_03, default, P8_03(PIN_INPUT, 7))
	BONE_PIN(P8_03, gpio,    P8_03(PIN_INPUT, 7))
	BONE_PIN(P8_03, gpio_pu, P8_03(PIN_INPUT_PULLUP, 7))
	BONE_PIN(P8_03, gpio_pd, P8_03(PIN_INPUT_PULLDOWN, 7))

	/* P8_04 (AC29) PRG0_PRU0_GPO5 (gpio0_48) */
	BONE_PIN(P8_04, default, P8_04(PIN_INPUT, 7))
	BONE_PIN(P8_04, gpio,    P8_04(PIN_INPUT, 7))
	BONE_PIN(P8_04, gpio_pu, P8_04(PIN_INPUT_PULLUP, 7))
	BONE_PIN(P8_04, gpio_pd, P8_04(PIN_INPUT_PULLDOWN, 7))

	/* P8_05 (AH25) PRG1_PRU1_GPO12 (gpio0_33) */
	BONE_PIN(P8_05, default, P8_05(PIN_INPUT, 7))
	BONE_PIN(P8_05, gpio,    P8_05(PIN_INPUT, 7))
	BONE_PIN(P8_05, gpio_pu, P8_05(PIN_INPUT_PULLUP, 7))
	BONE_PIN(P8_05, gpio_pd, P8_05(PIN_INPUT_PULLDOWN, 7))

	/* P8_06 (AG25) PRG1_PRU1_GPO13 (gpio0_34) */
	BONE_PIN(P8_06, default, P8_06(PIN_INPUT, 7))
	BONE_PIN(P8_06, gpio,    P8_06(PIN_INPUT, 7))
	BONE_PIN(P8_06, gpio_pu, P8_06(PIN_INPUT_PULLUP, 7))
	BONE_PIN(P8_06, gpio_pd, P8_06(PIN_INPUT_PULLDOWN, 7))

	/* P8_07 (AD24) PRG1_PRU0_GPO14 (gpio0_15) */
	BONE_PIN(P8_07, default, P8_07(PIN_INPUT, 7))
	BONE_PIN(P8_07, gpio,    P8_07(PIN_INPUT, 7))
	BONE_PIN(P8_07, gpio_pu, P8_07(PIN_INPUT_PULLUP, 7))
	BONE_PIN(P8_07, gpio_pd, P8_07(PIN_INPUT_PULLDOWN, 7))

	/* P8_08 (AG24) PRG1_PRU0_GPO13 (gpio0_14) */
	BONE_PIN(P8_08, default, P8_08(PIN_INPUT, 7))
	BONE_PIN(P8_08, gpio,    P8_08(PIN_INPUT, 7))
	BONE_PIN(P8_08, gpio_pu, P8_08(PIN_INPUT_PULLUP, 7))
	BONE_PIN(P8_08, gpio_pd, P8_08(PIN_INPUT_PULLDOWN, 7))

	/* P8_09 (AE24) PRG1_PRU0_GPO16 (gpio0_17) */
	BONE_PIN(P8_09, default, P8_09(PIN_INPUT, 7))
	BONE_PIN(P8_09, gpio,    P8_09(PIN_INPUT, 7))
	BONE_PIN(P8_09, gpio_pu, P8_09(PIN_INPUT_PULLUP, 7))
	BONE_PIN(P8_09, gpio_pd, P8_09(PIN_INPUT_PULLDOWN, 7))

	/* P8_11 (AB24) PRG0_PRU0_GPO17 (gpio0_60) */
	BONE_PIN(P8_11, default, P8_11(PIN_INPUT, 7))
	BONE_PIN(P8_11, gpio,    P8_11(PIN_INPUT, 7))
	BONE_PIN(P8_11, gpio_pu, P8_11(PIN_INPUT_PULLUP, 7))
	BONE_PIN(P8_11, gpio_pd, P8_11(PIN_INPUT_PULLDOWN, 7))

	/* P8_12 (AH28) PRG0_PRU0_GPO16 (gpio0_59) */
	BONE_PIN(P8_12, default, P8_12(PIN_INPUT, 7))
	BONE_PIN(P8_12, gpio,    P8_12(PIN_INPUT, 7))
	BONE_PIN(P8_12, gpio_pu, P8_12(PIN_INPUT_PULLUP, 7))
	BONE_PIN(P8_12, gpio_pd, P8_12(PIN_INPUT_PULLDOWN, 7))

	/* P8_13 (V27) RGMII5_TD1 (gpio0_89) */
	BONE_PIN(P8_13, default, P8_13(PIN_INPUT, 7))
	BONE_PIN(P8_13, gpio,    P8_13(PIN_INPUT, 7))
	BONE_PIN(P8_13, gpio_pu, P8_13(PIN_INPUT_PULLUP, 7))
	BONE_PIN(P8_13, gpio_pd, P8_13(PIN_INPUT_PULLDOWN, 7))

	/* P8_14 (AF27) PRG0_PRU1_GPO12 (gpio0_75) */
	BONE_PIN(P8_14, default, P8_14(PIN_INPUT, 7))
	BONE_PIN(P8_14, gpio,    P8_14(PIN_INPUT, 7))
	BONE_PIN(P8_14, gpio_pu, P8_14(PIN_INPUT_PULLUP, 7))
	BONE_PIN(P8_14, gpio_pd, P8_14(PIN_INPUT_PULLDOWN, 7))

	/* P8_15 (AB29) PRG0_PRU0_GPO18 (gpio0_61) */
	BONE_PIN(P8_15, default, P8_15(PIN_INPUT, 7))
	BONE_PIN(P8_15, gpio,    P8_15(PIN_INPUT, 7))
	BONE_PIN(P8_15, gpio_pu, P8_15(PIN_INPUT_PULLUP, 7))
	BONE_PIN(P8_15, gpio_pd, P8_15(PIN_INPUT_PULLDOWN, 7))

	/* P8_16 (AB28) PRG0_PRU0_GPO19 (gpio0_62) */
	BONE_PIN(P8_16, default, P8_16(PIN_INPUT, 7))
	BONE_PIN(P8_16, gpio,    P8_16(PIN_INPUT, 7))
	BONE_PIN(P8_16, gpio_pu, P8_16(PIN_INPUT_PULLUP, 7))
	BONE_PIN(P8_16, gpio_pd, P8_16(PIN_INPUT_PULLDOWN, 7))

	/* P8_17 (AF22) PRG1_PRU0_GPO2 (gpio0_3) */
	BONE_PIN(P8_17, default, P8_17(PIN_INPUT, 7))
	BONE_PIN(P8_17, gpio,    P8_17(PIN_INPUT, 7))
	BONE_PIN(P8_17, gpio_pu, P8_17(PIN_INPUT_PULLUP, 7))
	BONE_PIN(P8_17, gpio_pd, P8_17(PIN_INPUT_PULLDOWN, 7))
	BONE_PIN(P8_17, uart, P8_17(PIN_INPUT, 14))	/* uart1_rxd */

	/* P8_18 (AJ23) PRG1_PRU0_GPO3 (gpio0_4) */
	BONE_PIN(P8_18, default, P8_18(PIN_INPUT, 7))
	BONE_PIN(P8_18, gpio,    P8_18(PIN_INPUT, 7))
	BONE_PIN(P8_18, gpio_pu, P8_18(PIN_INPUT_PULLUP, 7))
	BONE_PIN(P8_18, gpio_pd, P8_18(PIN_INPUT_PULLDOWN, 7))
	BONE_PIN(P8_18, uart, P8_18(PIN_OUTPUT, 14))	/* uart1_txd */

	/* P8_19 (V29) RGMII5_TD2 (gpio0_88) */
	BONE_PIN(P8_19, default, P8_19(PIN_INPUT, 7))
	BONE_PIN(P8_19, gpio,    P8_19(PIN_INPUT, 7))
	BONE_PIN(P8_19, gpio_pu, P8_19(PIN_INPUT_PULLUP, 7))
	BONE_PIN(P8_19, gpio_pd, P8_19(PIN_INPUT_PULLDOWN, 7))
	BONE_PIN(P8_19, uart, P8_19(PIN_OUTPUT, 1))	/* uart3_txd */

	/* P8_20 (AF26) PRG0_PRU1_GPO13 (gpio0_76) */
	BONE_PIN(P8_20, default, P8_20(PIN_INPUT, 7))
	BONE_PIN(P8_20, gpio,    P8_20(PIN_INPUT, 7))
	BONE_PIN(P8_20, gpio_pu, P8_20(PIN_INPUT_PULLUP, 7))
	BONE_PIN(P8_20, gpio_pd, P8_20(PIN_INPUT_PULLDOWN, 7))

	/* P8_21 (AF21) PRG1_PRU1_GPO9 (gpio0_30) */
	BONE_PIN(P8_21, default, P8_21(PIN_INPUT, 7))
	BONE_PIN(P8_21, gpio,    P8_21(PIN_INPUT, 7))
	BONE_PIN(P8_21, gpio_pu, P8_21(PIN_INPUT_PULLUP, 7))
	BONE_PIN(P8_21, gpio_pd, P8_21(PIN_INPUT_PULLDOWN, 7))

	/* P8_22 (AH23) PRG1_PRU0_GPO4 (gpio0_5) */
	BONE_PIN(P8_22, default, P8_22(PIN_INPUT, 7))
	BONE_PIN(P8_22, gpio,    P8_22(PIN_INPUT, 7))
	BONE_PIN(P8_22, gpio_pu, P8_22(PIN_INPUT_PULLUP, 7))
	BONE_PIN(P8_22, gpio_pd, P8_22(PIN_INPUT_PULLDOWN, 7))
	BONE_PIN(P8_22, uart, P8_22(PIN_INPUT, 14))	/* uart2_rxd */

	/* P8_23 (AB23) PRG1_PRU1_GPO10 (gpio0_31) */
	BONE_PIN(P8_23, default, P8_23(PIN_INPUT, 7))
	BONE_PIN(P8_23, gpio,    P8_23(PIN_INPUT, 7))
	BONE_PIN(P8_23, gpio_pu, P8_23(PIN_INPUT_PULLUP, 7))
	BONE_PIN(P8_23, gpio_pd, P8_23(PIN_INPUT_PULLDOWN, 7))

	/* P8_24 (AD20) PRG1_PRU0_GPO5 (gpio0_6) */
	BONE_PIN(P8_24, default, P8_24(PIN_INPUT, 7))
	BONE_PIN(P8_24, gpio,    P8_24(PIN_INPUT, 7))
	BONE_PIN(P8_24, gpio_pu, P8_24(PIN_INPUT_PULLUP, 7))
	BONE_PIN(P8_24, gpio_pd, P8_24(PIN_INPUT_PULLDOWN, 7))

	/* P8_25 (AH26) PRG1_PRU1_GPO14 (gpio0_35) */
	BONE_PIN(P8_25, default, P8_25(PIN_INPUT, 7))
	BONE_PIN(P8_25, gpio,    P8_25(PIN_INPUT, 7))
	BONE_PIN(P8_25, gpio_pu, P8_25(PIN_INPUT_PULLUP, 7))
	BONE_PIN(P8_25, gpio_pd, P8_25(PIN_INPUT_PULLDOWN, 7))

	/* P8_26 (AC27) PRG0_PRU0_GPO8 (gpio0_51) */
	BONE_PIN(P8_26, default, P8_26(PIN_INPUT, 7))
	BONE_PIN(P8_26, gpio,    P8_26(PIN_INPUT, 7))
	BONE_PIN(P8_26, gpio_pu, P8_26(PIN_INPUT_PULLUP, 7))
	BONE_PIN(P8_26, gpio_pd, P8_26(PIN_INPUT_PULLDOWN, 7))
	BONE_PIN(P8_26, uart, P8_26(PIN_INPUT, 14))	/* uart6_rxd */

	/* P8_27 (AA28) PRG0_PRU1_GPO8 (gpio0_71) */
	BONE_PIN(P8_27, default, P8_27(PIN_INPUT, 7))
	BONE_PIN(P8_27, gpio,    P8_27(PIN_INPUT, 7))
	BONE_PIN(P8_27, gpio_pu, P8_27(PIN_INPUT_PULLUP, 7))
	BONE_PIN(P8_27, gpio_pd, P8_27(PIN_INPUT_PULLDOWN, 7))

	/* P8_28 (Y24) PRG0_PRU1_GPO9 (gpio0_72) */
	BONE_PIN(P8_28, default, P8_28(PIN_INPUT, 7))
	BONE_PIN(P8_28, gpio,    P8_28(PIN_INPUT, 7))
	BONE_PIN(P8_28, gpio_pu, P8_28(PIN_INPUT_PULLUP, 7))
	BONE_PIN(P8_28, gpio_pd, P8_28(PIN_INPUT_PULLDOWN, 7))
	BONE_PIN(P8_28, uart, P8_28(PIN_INPUT, 14))	/* uart8_rxd */

	/* P8_29 (AA25) PRG0_PRU1_GPO10 (gpio0_73) */
	BONE_PIN(P8_29, default, P8_29(PIN_INPUT, 7))
	BONE_PIN(P8_29, gpio,    P8_29(PIN_INPUT, 7))
	BONE_PIN(P8_29, gpio_pu, P8_29(PIN_INPUT_PULLUP, 7))
	BONE_PIN(P8_29, gpio_pd, P8_29(PIN_INPUT_PULLDOWN, 7))
	BONE_PIN(P8_29, uart, P8_29(PIN_OUTPUT, 14))	/* uart8_txd */

	/* P8_30 (AG26) PRG0_PRU1_GPO11 (gpio0_74) */
	BONE_PIN(P8_30, default, P8_30(PIN_INPUT, 7))
	BONE_PIN(P8_30, gpio,    P8_30(PIN_INPUT, 7))
	BONE_PIN(P8_30, gpio_pu, P8_30(PIN_INPUT_PULLUP, 7))
	BONE_PIN(P8_30, gpio_pd, P8_30(PIN_INPUT_PULLDOWN, 7))

	/* P8_31A (AJ25) PRG1_PRU1_GPO11 (gpio0_32) */
	BONE_PIN(P8_31A, default, P8_31A(PIN_INPUT, 7))
	BONE_PIN(P8_31A, gpio,    P8_31A(PIN_INPUT, 7))
	BONE_PIN(P8_31A, gpio_pu, P8_31A(PIN_INPUT_PULLUP, 7))
	BONE_PIN(P8_31A, gpio_pd, P8_31A(PIN_INPUT_PULLDOWN, 7))

	/* P8_31B (AE29) PRG0_PRU1_GPO0 (gpio0_63) */
	BONE_PIN(P8_31B, default, P8_31B(PIN_INPUT, 7))
	BONE_PIN(P8_31B, gpio,    P8_31B(PIN_INPUT, 7))
	BONE_PIN(P8_31B, gpio_pu, P8_31B(PIN_INPUT_PULLUP, 7))
	BONE_PIN(P8_31B, gpio_pd, P8_31B(PIN_INPUT_PULLDOWN, 7))
	BONE_PIN(P8_31B, uart, P8_31B(PIN_INPUT, 14))	/* uart5_rxd */

	/* P8_32A (AG21) PRG1_PRU1_GPO5 (gpio0_26) */
	BONE_PIN(P8_32A, default, P8_32A(PIN_INPUT, 7))
	BONE_PIN(P8_32A, gpio,    P8_32A(PIN_INPUT, 7))
	BONE_PIN(P8_32A, gpio_pu, P8_32A(PIN_INPUT_PULLUP, 7))
	BONE_PIN(P8_32A, gpio_pd, P8_32A(PIN_INPUT_PULLDOWN, 7))

	/* P8_32B (AD28) PRG0_PRU1_GPO1 (gpio0_64) */
	BONE_PIN(P8_32B, default, P8_32B(PIN_INPUT, 7))
	BONE_PIN(P8_32B, gpio,    P8_32B(PIN_INPUT, 7))
	BONE_PIN(P8_32B, gpio_pu, P8_32B(PIN_INPUT_PULLUP, 7))
	BONE_PIN(P8_32B, gpio_pd, P8_32B(PIN_INPUT_PULLDOWN, 7))
	BONE_PIN(P8_32B, uart, P8_32B(PIN_OUTPUT, 14))	/* uart5_txd */

	/* P8_33A (AH24) PRG1_PRU1_GPO4 (gpio0_25) */
	BONE_PIN(P8_33A, default, P8_33A(PIN_INPUT, 7))
	BONE_PIN(P8_33A, gpio,    P8_33A(PIN_INPUT, 7))
	BONE_PIN(P8_33A, gpio_pu, P8_33A(PIN_INPUT_PULLUP, 7))
	BONE_PIN(P8_33A, gpio_pd, P8_33A(PIN_INPUT_PULLDOWN, 7))

	/* P8_33B (AA2) SPI0_CS0 (gpio0_111) */
	BONE_PIN(P8_33B, default, P8_33B(PIN_INPUT, 7))
	BONE_PIN(P8_33B, gpio,    P8_33B(PIN_INPUT, 7))
	BONE_PIN(P8_33B, gpio_pu, P8_33B(PIN_INPUT_PULLUP, 7))
	BONE_PIN(P8_33B, gpio_pd, P8_33B(PIN_INPUT_PULLDOWN, 7))

	/* P8_34 (AD22) PRG1_PRU0_GPO6 (gpio0_7) */
	BONE_PIN(P8_34, default, P8_34(PIN_INPUT, 7))
	BONE_PIN(P8_34, gpio,    P8_34(PIN_INPUT, 7))
	BONE_PIN(P8_34, gpio_pu, P8_34(PIN_INPUT_PULLUP, 7))
	BONE_PIN(P8_34, gpio_pd, P8_34(PIN_INPUT_PULLDOWN, 7))
	BONE_PIN(P8_34, uart, P8_34(PIN_OUTPUT, 14))	/* uart2_txd */

	/* P8_35A (AD23) PRG1_PRU1_GPO3 (gpio0_24) */
	BONE_PIN(P8_35A, default, P8_35A(PIN_INPUT, 7))
	BONE_PIN(P8_35A, gpio,    P8_35A(PIN_INPUT, 7))
	BONE_PIN(P8_35A, gpio_pu, P8_35A(PIN_INPUT_PULLUP, 7))
	BONE_PIN(P8_35A, gpio_pd, P8_35A(PIN_INPUT_PULLDOWN, 7))

	/* P8_35B (Y3) SPI1_CS0 (gpio0_116) */
	BONE_PIN(P8_35B, default, P8_35B(PIN_INPUT, 7))
	BONE_PIN(P8_35B, gpio,    P8_35B(PIN_INPUT, 7))
	BONE_PIN(P8_35B, gpio_pu, P8_35B(PIN_INPUT_PULLUP, 7))
	BONE_PIN(P8_35B, gpio_pd, P8_35B(PIN_INPUT_PULLDOWN, 7))
	BONE_PIN(P8_35B, uart, P8_35B(PIN_INPUT, 3))	/* uart5_rxd */

	/* P8_36 (AE20) PRG1_PRU0_GPO7 (gpio0_8) */
	BONE_PIN(P8_36, default, P8_36(PIN_INPUT, 7))
	BONE_PIN(P8_36, gpio,    P8_36(PIN_INPUT, 7))
	BONE_PIN(P8_36, gpio_pu, P8_36(PIN_INPUT_PULLUP, 7))
	BONE_PIN(P8_36, gpio_pd, P8_36(PIN_INPUT_PULLDOWN, 7))

	/* P8_37A (AD21) PRG1_PRU0_GPO10 (gpio0_11) */
	BONE_PIN(P8_37A, default, P8_37A(PIN_INPUT, 7))
	BONE_PIN(P8_37A, gpio,    P8_37A(PIN_INPUT, 7))
	BONE_PIN(P8_37A, gpio_pu, P8_37A(PIN_INPUT_PULLUP, 7))
	BONE_PIN(P8_37A, gpio_pd, P8_37A(PIN_INPUT_PULLDOWN, 7))

	/* P8_37B (Y27) RGMII6_RD2 (gpio0_106) */
	BONE_PIN(P8_37B, default, P8_37B(PIN_INPUT, 7))
	BONE_PIN(P8_37B, gpio,    P8_37B(PIN_INPUT, 7))
	BONE_PIN(P8_37B, gpio_pu, P8_37B(PIN_INPUT_PULLUP, 7))
	BONE_PIN(P8_37B, gpio_pd, P8_37B(PIN_INPUT_PULLDOWN, 7))
	BONE_PIN(P8_37B, uart, P8_37B(PIN_OUTPUT, 3))	/* uart5_txd */

	/* P8_38A (AJ20) PRG1_PRU0_GPO8 (gpio0_9) */
	BONE_PIN(P8_38A, default, P8_38A(PIN_INPUT, 7))
	BONE_PIN(P8_38A, gpio,    P8_38A(PIN_INPUT, 7))
	BONE_PIN(P8_38A, gpio_pu, P8_38A(PIN_INPUT_PULLUP, 7))
	BONE_PIN(P8_38A, gpio_pd, P8_38A(PIN_INPUT_PULLDOWN, 7))

	/* P8_38B (Y29) RGMII6_RD3 (gpio0_105) */
	BONE_PIN(P8_38B, default, P8_38B(PIN_INPUT, 7))
	BONE_PIN(P8_38B, gpio,    P8_38B(PIN_INPUT, 7))
	BONE_PIN(P8_38B, gpio_pu, P8_38B(PIN_INPUT_PULLUP, 7))
	BONE_PIN(P8_38B, gpio_pd, P8_38B(PIN_INPUT_PULLDOWN, 7))
	BONE_PIN(P8_38B, uart, P8_38B(PIN_INPUT, 3))	/* uart5_rxd */

	/* P8_39 (AC26) PRG0_PRU1_GPO6 (gpio0_69) */
	BONE_PIN(P8_39, default, P8_39(PIN_INPUT, 7))
	BONE_PIN(P8_39, gpio,    P8_39(PIN_INPUT, 7))
	BONE_PIN(P8_39, gpio_pu, P8_39(PIN_INPUT_PULLUP, 7))
	BONE_PIN(P8_39, gpio_pd, P8_39(PIN_INPUT_PULLDOWN, 7))

	/* P8_40 (AA24) PRG0_PRU1_GPO7 (gpio0_70) */
	BONE_PIN(P8_40, default, P8_40(PIN_INPUT, 7))
	BONE_PIN(P8_40, gpio,    P8_40(PIN_INPUT, 7))
	BONE_PIN(P8_40, gpio_pu, P8_40(PIN_INPUT_PULLUP, 7))
	BONE_PIN(P8_40, gpio_pd, P8_40(PIN_INPUT_PULLDOWN, 7))
	BONE_PIN(P8_40, uart, P8_40(PIN_OUTPUT, 14))	/* uart2_txd */

	/* P8_41 (AD29) PRG0_PRU1_GPO4 (gpio0_67) */
	BONE_PIN(P8_41, default, P8_41(PIN_INPUT, 7))
	BONE_PIN(P8_41, gpio,    P8_41(PIN_INPUT, 7))
	BONE_PIN(P8_41, gpio_pu, P8_41(PIN_INPUT_PULLUP, 7))
	BONE_PIN(P8_41, gpio_pd, P8_41(PIN_INPUT_PULLDOWN, 7))

	/* P8_42 (AB27) PRG0_PRU1_GPO5 (gpio0_68) */
	BONE_PIN(P8_42, default, P8_42(PIN_INPUT, 7))
	BONE_PIN(P8_42, gpio,    P8_42(PIN_INPUT, 7))
	BONE_PIN(P8_42, gpio_pu, P8_42(PIN_INPUT_PULLUP, 7))
	BONE_PIN(P8_42, gpio_pd, P8_42(PIN_INPUT_PULLDOWN, 7))

	/* P8_43 (AD27) PRG0_PRU1_GPO2 (gpio0_65) */
	BONE_PIN(P8_43, default, P8_43(PIN_INPUT, 7))
	BONE_PIN(P8_43, gpio,    P8_43(PIN_INPUT, 7))
	BONE_PIN(P8_43, gpio_pu, P8_43(PIN_INPUT_PULLUP, 7))
	BONE_PIN(P8_43, gpio_pd, P8_43(PIN_INPUT_PULLDOWN, 7))

	/* P8_44 (AC25) PRG0_PRU1_GPO3 (gpio0_66) */
	BONE_PIN(P8_44, default, P8_44(PIN_INPUT, 7))
	BONE_PIN(P8_44, gpio,    P8_44(PIN_INPUT, 7))
	BONE_PIN(P8_44, gpio_pu, P8_44(PIN_INPUT_PULLUP, 7))
	BONE_PIN(P8_44, gpio_pd, P8_44(PIN_INPUT_PULLDOWN, 7))

	/* P8_45 (AG29) PRG0_PRU1_GPO16 (gpio0_79) */
	BONE_PIN(P8_45, default, P8_45(PIN_INPUT, 7))
	BONE_PIN(P8_45, gpio,    P8_45(PIN_INPUT, 7))
	BONE_PIN(P8_45, gpio_pu, P8_45(PIN_INPUT_PULLUP, 7))
	BONE_PIN(P8_45, gpio_pd, P8_45(PIN_INPUT_PULLDOWN, 7))

	/* P8_46 (Y25) PRG0_PRU1_GPO17 (gpio0_80) */
	BONE_PIN(P8_46, default, P8_46(PIN_INPUT, 7))
	BONE_PIN(P8_46, gpio,    P8_46(PIN_INPUT, 7))
	BONE_PIN(P8_46, gpio_pu, P8_46(PIN_INPUT_PULLUP, 7))
	BONE_PIN(P8_46, gpio_pd, P8_46(PIN_INPUT_PULLDOWN, 7))

	/* P9_01 - GND */
	/* P9_02 - GND */
	/* P9_03 - VOUT_3V3 */
	/* P9_04 - VOUT_3V3 */
	/* P9_05 - VIN */
	/* P9_06 - VIN */
	/* P9_07 - VOUT_SYS */
	/* P9_08 - VOUT_SYS */
	/* P9_09 - RESET# */
	/* P9_10 - POWER# */

	/* P9_11 (AC23) PRG1_PRU0_GPO0 (gpio0_1) */
	BONE_PIN(P9_11, default, P9_11(PIN_INPUT, 7))
	BONE_PIN(P9_11, gpio,    P9_11(PIN_INPUT, 7))
	BONE_PIN(P9_11, gpio_pu, P9_11(PIN_INPUT_PULLUP, 7))
	BONE_PIN(P9_11, gpio_pd, P9_11(PIN_INPUT_PULLDOWN, 7))
	BONE_PIN(P9_11, uart, P9_11(PIN_INPUT, 14))	/* uart0_rxd */

	/* P9_12 (AE27) PRG0_PRU0_GPO2 (gpio0_45) */
	BONE_PIN(P9_12, default, P9_12(PIN_INPUT, 7))
	BONE_PIN(P9_12, gpio,    P9_12(PIN_INPUT, 7))
	BONE_PIN(P9_12, gpio_pu, P9_12(PIN_INPUT_PULLUP, 7))
	BONE_PIN(P9_12, gpio_pd, P9_12(PIN_INPUT_PULLDOWN, 7))
	BONE_PIN(P9_12, uart, P9_12(PIN_INPUT, 8))	/* uart3_rxd */

	/* P9_13 (AG22) PRG1_PRU0_GPO1 (gpio0_2) */
	BONE_PIN(P9_13, default, P9_13(PIN_INPUT, 7))
	BONE_PIN(P9_13, gpio,    P9_13(PIN_INPUT, 7))
	BONE_PIN(P9_13, gpio_pu, P9_13(PIN_INPUT_PULLUP, 7))
	BONE_PIN(P9_13, gpio_pd, P9_13(PIN_INPUT_PULLDOWN, 7))
	BONE_PIN(P9_13, uart, P9_13(PIN_OUTPUT, 14))	/* uart0_txd */

	/* P9_14 (U27) RGMII5_RD3 (gpio0_93) */
	BONE_PIN(P9_14, default, P9_14(PIN_INPUT, 7))
	BONE_PIN(P9_14, gpio,    P9_14(PIN_INPUT, 7))
	BONE_PIN(P9_14, gpio_pu, P9_14(PIN_INPUT_PULLUP, 7))
	BONE_PIN(P9_14, gpio_pd, P9_14(PIN_INPUT_PULLDOWN, 7))
	BONE_PIN(P9_14, uart, P9_14(PIN_INPUT, 3))	/* uart6_rxd */

	/* P9_15 (AD25) PRG0_PRU0_GPO4 (gpio0_47) */
	BONE_PIN(P9_15, default, P9_15(PIN_INPUT, 7))
	BONE_PIN(P9_15, gpio,    P9_15(PIN_INPUT, 7))
	BONE_PIN(P9_15, gpio_pu, P9_15(PIN_INPUT_PULLUP, 7))
	BONE_PIN(P9_15, gpio_pd, P9_15(PIN_INPUT_PULLDOWN, 7))

	/* P9_16 (U24) RGMII5_RD2 (gpio0_94) */
	BONE_PIN(P9_16, default, P9_16(PIN_INPUT, 7))
	BONE_PIN(P9_16, gpio,    P9_16(PIN_INPUT, 7))
	BONE_PIN(P9_16, gpio_pu, P9_16(PIN_INPUT_PULLUP, 7))
	BONE_PIN(P9_16, gpio_pd, P9_16(PIN_INPUT_PULLDOWN, 7))
	BONE_PIN(P9_16, uart, P9_16(PIN_OUTPUT, 3))	/* uart6_txd */

	/* P9_17B (AA3) SPI0_D1 (gpio0_115) */
	BONE_PIN(P9_17B, default, P9_17B(PIN_INPUT, 7))
	BONE_PIN(P9_17B, gpio,    P9_17B(PIN_INPUT, 7))
	BONE_PIN(P9_17B, gpio_pu, P9_17B(PIN_INPUT_PULLUP, 7))
	BONE_PIN(P9_17B, gpio_pd, P9_17B(PIN_INPUT_PULLDOWN, 7))

	/* P9_18A (AH22) PRG1_PRU1_GPO19 (gpio0_40) */
	BONE_PIN(P9_18A, default, P9_18A(PIN_INPUT, 7))
	BONE_PIN(P9_18A, gpio,    P9_18A(PIN_INPUT, 7))
	BONE_PIN(P9_18A, gpio_pu, P9_18A(PIN_INPUT_PULLUP, 7))
	BONE_PIN(P9_18A, gpio_pd, P9_18A(PIN_INPUT_PULLDOWN, 7))

	/* P9_18B (Y2) SPI1_D1 (gpio0_120) */
	BONE_PIN(P9_18B, default, P9_18B(PIN_INPUT, 7))
	BONE_PIN(P9_18B, gpio,    P9_18B(PIN_INPUT, 7))
	BONE_PIN(P9_18B, gpio_pu, P9_18B(PIN_INPUT_PULLUP, 7))
	BONE_PIN(P9_18B, gpio_pd, P9_18B(PIN_INPUT_PULLDOWN, 7))

	/* P9_19A (W5) MCAN0_RX (gpio1_1) */
	BONE_PIN(P9_19A, default, P9_19A(PIN_INPUT, 7))
	BONE_PIN(P9_19A, gpio,    P9_19A(PIN_INPUT, 7))
	BONE_PIN(P9_19A, gpio_pu, P9_19A(PIN_INPUT_PULLUP, 7))
	BONE_PIN(P9_19A, gpio_pd, P9_19A(PIN_INPUT_PULLDOWN, 7))

	/* P9_19B (AF29) PRG0_PRU1_GPO15 (gpio0_78) */
	BONE_PIN(P9_19B, default, P9_19B(PIN_INPUT, 7))
	BONE_PIN(P9_19B, gpio,    P9_19B(PIN_INPUT, 7))
	BONE_PIN(P9_19B, gpio_pu, P9_19B(PIN_INPUT_PULLUP, 7))
	BONE_PIN(P9_19B, gpio_pd, P9_19B(PIN_INPUT_PULLDOWN, 7))

	/* P9_20A (W6) MCAN0_TX (gpio1_2) */
	BONE_PIN(P9_20A, default, P9_20A(PIN_INPUT, 7))
	BONE_PIN(P9_20A, gpio,    P9_20A(PIN_INPUT, 7))
	BONE_PIN(P9_20A, gpio_pu, P9_20A(PIN_INPUT_PULLUP, 7))
	BONE_PIN(P9_20A, gpio_pd, P9_20A(PIN_INPUT_PULLDOWN, 7))

	/* P9_20B (AE25) PRG0_PRU1_GPO14 (gpio0_77) */
	BONE_PIN(P9_20B, default, P9_20B(PIN_INPUT, 7))
	BONE_PIN(P9_20B, gpio,    P9_20B(PIN_INPUT, 7))
	BONE_PIN(P9_20B, gpio_pu, P9_20B(PIN_INPUT_PULLUP, 7))
	BONE_PIN(P9_20B, gpio_pd, P9_20B(PIN_INPUT_PULLDOWN, 7))

	/* P9_21A (AJ22) PRG1_PRU1_GPO18 (gpio0_39) */
	BONE_PIN(P9_21A, default, P9_21A(PIN_INPUT, 7))
	BONE_PIN(P9_21A, gpio,    P9_21A(PIN_INPUT, 7))
	BONE_PIN(P9_21A, gpio_pu, P9_21A(PIN_INPUT_PULLUP, 7))
	BONE_PIN(P9_21A, gpio_pd, P9_21A(PIN_INPUT_PULLDOWN, 7))

	/* P9_21B (U28) RGMII5_TD0 (gpio0_90) */
	BONE_PIN(P9_21B, default, P9_21B(PIN_INPUT, 7))
	BONE_PIN(P9_21B, gpio,    P9_21B(PIN_INPUT, 7))
	BONE_PIN(P9_21B, gpio_pu, P9_21B(PIN_INPUT_PULLUP, 7))
	BONE_PIN(P9_21B, gpio_pd, P9_21B(PIN_INPUT_PULLDOWN, 7))

	/* P9_22A (AC22) PRG1_PRU1_GPO17 (gpio0_38) */
	BONE_PIN(P9_22A, default, P9_22A(PIN_INPUT, 7))
	BONE_PIN(P9_22A, gpio,    P9_22A(PIN_INPUT, 7))
	BONE_PIN(P9_22A, gpio_pu, P9_22A(PIN_INPUT_PULLUP, 7))
	BONE_PIN(P9_22A, gpio_pd, P9_22A(PIN_INPUT_PULLDOWN, 7))

	/* P9_22B (U29) RGMII5_TXC (gpio0_91) */
	BONE_PIN(P9_22B, default, P9_22B(PIN_INPUT, 7))
	BONE_PIN(P9_22B, gpio,    P9_22B(PIN_INPUT, 7))
	BONE_PIN(P9_22B, gpio_pu, P9_22B(PIN_INPUT_PULLUP, 7))
	BONE_PIN(P9_22B, gpio_pd, P9_22B(PIN_INPUT_PULLDOWN, 7))

	/* P9_23 (AG20) PRG1_PRU0_GPO9 (gpio0_10) */
	BONE_PIN(P9_23, default, P9_23(PIN_INPUT, 7))
	BONE_PIN(P9_23, gpio,    P9_23(PIN_INPUT, 7))
	BONE_PIN(P9_23, gpio_pu, P9_23(PIN_INPUT_PULLUP, 7))
	BONE_PIN(P9_23, gpio_pd, P9_23(PIN_INPUT_PULLDOWN, 7))

	/* P9_24A (Y5) SPI1_D0 (gpio0_119) */
	BONE_PIN(P9_24A, default, P9_24A(PIN_INPUT, 7))
	BONE_PIN(P9_24A, gpio,    P9_24A(PIN_INPUT, 7))
	BONE_PIN(P9_24A, gpio_pu, P9_24A(PIN_INPUT_PULLUP, 7))
	BONE_PIN(P9_24A, gpio_pd, P9_24A(PIN_INPUT_PULLDOWN, 7))
	BONE_PIN(P9_24A, uart, P9_24A(PIN_OUTPUT, 3))	/* uart2_txd */

	/* P9_24B (AJ24) PRG1_PRU0_GPO12 (gpio0_13) */
	BONE_PIN(P9_24B, default, P9_24B(PIN_INPUT, 7))
	BONE_PIN(P9_24B, gpio,    P9_24B(PIN_INPUT, 7))
	BONE_PIN(P9_24B, gpio_pu, P9_24B(PIN_INPUT_PULLUP, 7))
	BONE_PIN(P9_24B, gpio_pd, P9_24B(PIN_INPUT_PULLDOWN, 7))

	/* P9_25A (AC4) UART1_CTSn (gpio0_127) */
	BONE_PIN(P9_25A, default, P9_25A(PIN_INPUT, 7))
	BONE_PIN(P9_25A, gpio,    P9_25A(PIN_INPUT, 7))
	BONE_PIN(P9_25A, gpio_pu, P9_25A(PIN_INPUT_PULLUP, 7))
	BONE_PIN(P9_25A, gpio_pd, P9_25A(PIN_INPUT_PULLDOWN, 7))

	/* P9_25B (W26) RGMII6_RXC (gpio0_104) */
	BONE_PIN(P9_25B, default, P9_25B(PIN_INPUT, 7))
	BONE_PIN(P9_25B, gpio,    P9_25B(PIN_INPUT, 7))
	BONE_PIN(P9_25B, gpio_pu, P9_25B(PIN_INPUT_PULLUP, 7))
	BONE_PIN(P9_25B, gpio_pd, P9_25B(PIN_INPUT_PULLDOWN, 7))

	/* P9_26A (Y1) SPI1_CLK (gpio0_118) */
	BONE_PIN(P9_26A, default, P9_26A(PIN_INPUT, 7))
	BONE_PIN(P9_26A, gpio,    P9_26A(PIN_INPUT, 7))
	BONE_PIN(P9_26A, gpio_pu, P9_26A(PIN_INPUT_PULLUP, 7))
	BONE_PIN(P9_26A, gpio_pd, P9_26A(PIN_INPUT_PULLDOWN, 7))
	BONE_PIN(P9_26A, uart, P9_26A(PIN_INPUT, 3))	/* uart2_rxd */

	/* P9_26B (AF24) PRG1_PRU0_GPO11 (gpio0_12) */
	BONE_PIN(P9_26B, default, P9_26B(PIN_INPUT, 7))
	BONE_PIN(P9_26B, gpio,    P9_26B(PIN_INPUT, 7))
	BONE_PIN(P9_26B, gpio_pu, P9_26B(PIN_INPUT_PULLUP, 7))
	BONE_PIN(P9_26B, gpio_pd, P9_26B(PIN_INPUT_PULLDOWN, 7))

	/* P9_27A (AD26) PRG0_PRU0_GPO3 (gpio0_46) */
	BONE_PIN(P9_27A, default, P9_27A(PIN_INPUT, 7))
	BONE_PIN(P9_27A, gpio,    P9_27A(PIN_INPUT, 7))
	BONE_PIN(P9_27A, gpio_pu, P9_27A(PIN_INPUT_PULLUP, 7))
	BONE_PIN(P9_27A, gpio_pd, P9_27A(PIN_INPUT_PULLDOWN, 7))
	BONE_PIN(P9_27A, uart, P9_27A(PIN_OUTPUT, 8))	/* uart3_txd */

	/* P9_27B (AB1) UART0_RTSn (gpio0_124) */
	BONE_PIN(P9_27B, default, P9_27B(PIN_INPUT, 7))
	BONE_PIN(P9_27B, gpio,    P9_27B(PIN_INPUT, 7))
	BONE_PIN(P9_27B, gpio_pu, P9_27B(PIN_INPUT_PULLUP, 7))
	BONE_PIN(P9_27B, gpio_pd, P9_27B(PIN_INPUT_PULLDOWN, 7))

	/* P9_28A (U2) ECAP0_IN_APWM_OUT (gpio1_11) */
	BONE_PIN(P9_28A, default, P9_28A(PIN_INPUT, 7))
	BONE_PIN(P9_28A, gpio,    P9_28A(PIN_INPUT, 7))
	BONE_PIN(P9_28A, gpio_pu, P9_28A(PIN_INPUT_PULLUP, 7))
	BONE_PIN(P9_28A, gpio_pd, P9_28A(PIN_INPUT_PULLDOWN, 7))

	/* P9_28B (AF28) PRG0_PRU0_GPO0 (gpio0_43) */
	BONE_PIN(P9_28B, default, P9_28B(PIN_INPUT, 7))
	BONE_PIN(P9_28B, gpio,    P9_28B(PIN_INPUT, 7))
	BONE_PIN(P9_28B, gpio_pu, P9_28B(PIN_INPUT_PULLUP, 7))
	BONE_PIN(P9_28B, gpio_pd, P9_28B(PIN_INPUT_PULLDOWN, 7))

	/* P9_29A (V5) TIMER_IO1 (gpio1_14) */
	BONE_PIN(P9_29A, default, P9_29A(PIN_INPUT, 7))
	BONE_PIN(P9_29A, gpio,    P9_29A(PIN_INPUT, 7))
	BONE_PIN(P9_29A, gpio_pu, P9_29A(PIN_INPUT_PULLUP, 7))
	BONE_PIN(P9_29A, gpio_pd, P9_29A(PIN_INPUT_PULLDOWN, 7))

	/* P9_29B (AB25) PRG0_PRU0_GPO10 (gpio0_53) */
	BONE_PIN(P9_29B, default, P9_29B(PIN_INPUT, 7))
	BONE_PIN(P9_29B, gpio,    P9_29B(PIN_INPUT, 7))
	BONE_PIN(P9_29B, gpio_pu, P9_29B(PIN_INPUT_PULLUP, 7))
	BONE_PIN(P9_29B, gpio_pd, P9_29B(PIN_INPUT_PULLDOWN, 7))

	/* P9_30A (V6) TIMER_IO0 (gpio1_13) */
	BONE_PIN(P9_30A, default, P9_30A(PIN_INPUT, 7))
	BONE_PIN(P9_30A, gpio,    P9_30A(PIN_INPUT, 7))
	BONE_PIN(P9_30A, gpio_pu, P9_30A(PIN_INPUT_PULLUP, 7))
	BONE_PIN(P9_30A, gpio_pd, P9_30A(PIN_INPUT_PULLDOWN, 7))

	/* P9_30B (AE28) PRG0_PRU0_GPO1 (gpio0_44) */
	BONE_PIN(P9_30B, default, P9_30B(PIN_INPUT, 7))
	BONE_PIN(P9_30B, gpio,    P9_30B(PIN_INPUT, 7))
	BONE_PIN(P9_30B, gpio_pu, P9_30B(PIN_INPUT_PULLUP, 7))
	BONE_PIN(P9_30B, gpio_pd, P9_30B(PIN_INPUT_PULLDOWN, 7))

	/* P9_31A (U3) EXT_REFCLK1 (gpio1_12) */
	BONE_PIN(P9_31A, default, P9_31A(PIN_INPUT, 7))
	BONE_PIN(P9_31A, gpio,    P9_31A(PIN_INPUT, 7))
	BONE_PIN(P9_31A, gpio_pu, P9_31A(PIN_INPUT_PULLUP, 7))
	BONE_PIN(P9_31A, gpio_pd, P9_31A(PIN_INPUT_PULLDOWN, 7))

	/* P9_31B (AB26) PRG0_PRU0_GPO9 (gpio0_52) */
	BONE_PIN(P9_31B, default, P9_31B(PIN_INPUT, 7))
	BONE_PIN(P9_31B, gpio,    P9_31B(PIN_INPUT, 7))
	BONE_PIN(P9_31B, gpio_pu, P9_31B(PIN_INPUT_PULLUP, 7))
	BONE_PIN(P9_31B, gpio_pd, P9_31B(PIN_INPUT_PULLDOWN, 7))
	BONE_PIN(P9_31B, uart, P9_31B(PIN_OUTPUT, 14))	/* uart6_txd */

	/* P9_43 - GND */
	/* P9_44 - GND */
	/* P9_45 - GND */
	/* P9_46 - GND */


