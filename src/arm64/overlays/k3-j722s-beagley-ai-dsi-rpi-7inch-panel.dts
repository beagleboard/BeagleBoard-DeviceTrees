// SPDX-License-Identifier: GPL-2.0
/**
 * DT Overlay for RPi 7inch touchscreen panel interfaced with DSI on
 *
 * RPi DSI Panel: https://www.raspberrypi.com/products/raspberry-pi-touch-display/
 *
 * Copyright (C) 2023 Texas Instruments Incorporated - https://www.ti.com/
 */

/dts-v1/;
/plugin/;

#include <dt-bindings/gpio/gpio.h>
//#include "k3-pinctrl.h"

/*
 * Helper to show loaded overlays under: /proc/device-tree/chosen/overlays/
 */
&{/chosen} {
	overlays {
		k3-j722s-beagley-ai-dsi-rpi-7inch-panel.kernel = __TIMESTAMP__;
	};
};

&dsi0 {
	status = "okay";
	bridge@0 {
		status = "okay";
	};
};
