// SPDX-License-Identifier: GPL-2.0-only OR MIT
/*
 * Copyright (C) BeagleBoard.org Foundation
 */

/dts-v1/;
/plugin/;

/*
 * Helper to show loaded overlays under: /proc/device-tree/chosen/overlays/
 */
&{/chosen} {
	overlays {
		BONE-I2C3.kernel = __TIMESTAMP__;
	};
};

&bone_i2c_3 {
	status = "okay";
	clock-frequency = <100000>;
	symlink = "bone/i2c/3";
};
